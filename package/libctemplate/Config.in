## package/libctemplate/Config.in
```kconfig
config BR2_PACKAGE_LIBCTEMPLATE
  bool "libctemplate"
  help
    C Template is a template expander library written in C and is 
    similar to the perl HTML::Template module.

    http://libctemplate.sourceforge.net/
```

## package/megatools/Config.in
```kconfig
config BR2_PACKAGE_MEGATOOLS
	bool "megatools"
	select BR2_PACKAGE_LIBCURL
	select BR2_PACKAGE_LIBGLIB2
	select BR2_PACKAGE_OPENSSL
	help
	  Open-source command line tools for accessing Mega.co.nz cloud storage

	  https://megous.com/git/megatools
```

## package/utelnetd/Config.in
```kconfig
config BR2_PACKAGE_UTELNETD
	bool "utelnetd"
	help
	  The utelnetd package provides a small and efficient stand alone telnet
	  server daemon.

	  http://www.pengutronix.de/software/utelnetd/download
```
